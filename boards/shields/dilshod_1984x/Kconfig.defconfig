## boards/shields/dilshod_1984x/Kconfig.defconfig
```kconfig
if SHIELD_DILSHOD_1984X_LEFT

config ZMK_KEYBOARD_NAME
    default "1984x"

config ZMK_SPLIT_ROLE_CENTRAL
    default y

endif # SHIELD_DILSHOD_1984X_LEFT

if SHIELD_DILSHOD_1984X_LEFT || SHIELD_DILSHOD_1984X_RIGHT

config ZMK_SPLIT
    default y

endif # SHIELD_DILSHOD_1984X_LEFT || SHIELD_DILSHOD_1984X_RIGHT
```

## boards/shields/dilshod_1984x/Kconfig.shield
```kconfig
config SHIELD_DILSHOD_1984X_LEFT
    def_bool $(shields_list_contains,dilshod_1984x_left)

config SHIELD_DILSHOD_1984X_RIGHT
    def_bool $(shields_list_contains,dilshod_1984x_right)
```
